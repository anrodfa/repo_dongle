## dts/bindings/behaviors/zmk,behavior-pmw-cpi.yaml
```yaml
description: PMW3610 CPI behavior

compatible: "zmk,behavior-pmw-cpi"

include: two_param.yaml
```

## dts/bindings/behaviors/zmk,behavior-rtc-adjust.yaml
```yaml
description: Ajuste a mano del reloj DS3231 del dongle

compatible: "zmk,behavior-rtc-adjust"

include: one_param.yaml
```
